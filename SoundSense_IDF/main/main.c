#include <stdio.h>
#include <string.h>
#include "freertos/FreeRTOS.h"
#include "freertos/task.h"
#include "driver/i2c.h"
#include "driver/uart.h"
#include "esp_log.h"
#include "ssd1306.h"

static const char *TAG = "SoundSense";

#define I2C_MASTER_SCL_IO           9
#define I2C_MASTER_SDA_IO           8
#define I2C_MASTER_NUM              I2C_NUM_0
#define I2C_MASTER_FREQ_HZ          400000

#define UART_NUM                    UART_NUM_0
#define UART_BUF_SIZE               1024

// Professional SoundSense Logo (128x64) - Geometric Pulse Design
static const uint8_t soundsense_logo[] = {
    0x00, 0x00, 0x00, 0x00, 0x00, 0x00, 0x00, 0x00, 0x00, 0x00, 0x00, 0x00, 0x00, 0x00, 0x00, 0x00,
    0x00, 0x00, 0x00, 0x00, 0x00, 0x00, 0x00, 0x00, 0x00, 0x00, 0x00, 0x00, 0x00, 0x00, 0x00, 0x00,
    0x00, 0x00, 0x00, 0x00, 0x00, 0x00, 0x00, 0x00, 0x00, 0x00, 0x00, 0x00, 0x00, 0x00, 0x00, 0x00,
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    0x00, 0x00, 0x00, 0x00, 0x00, 0x00, 0x00, 0x00, 0x00, 0x00, 0x00, 0x00, 0x00, 0x00, 0x00, 0x00,
};


static void i2c_master_init() {
    i2c_config_t conf = {
        .mode = I2C_MODE_MASTER,
        .sda_io_num = I2C_MASTER_SDA_IO,
        .sda_pullup_en = GPIO_PULLUP_ENABLE,
        .scl_io_num = I2C_MASTER_SCL_IO,
        .scl_pullup_en = GPIO_PULLUP_ENABLE,
        .master.clk_speed = I2C_MASTER_FREQ_HZ,
    };
    i2c_param_config(I2C_MASTER_NUM, &conf);
    i2c_driver_install(I2C_MASTER_NUM, conf.mode, 0, 0, 0);
}

static void uart_init() {
    uart_config_t uart_config = {
        .baud_rate = 115200,
        .data_bits = UART_DATA_8_BITS,
        .parity = UART_PARITY_DISABLE,
        .stop_bits = UART_STOP_BITS_1,
        .flow_ctrl = UART_HW_FLOWCTRL_DISABLE,
    };
    uart_param_config(UART_NUM, &uart_config);
    uart_driver_install(UART_NUM, UART_BUF_SIZE * 2, 0, 0, NULL, 0);
}

void app_main(void) {
    i2c_master_init();
    uart_init();

    ssd1306_t dev;
    // Scan for 0x3C or 0x3D
    uint8_t addr = 0x3C;
    i2c_cmd_handle_t cmd = i2c_cmd_link_create();
    i2c_master_start(cmd);
    i2c_master_write_byte(cmd, (0x3C << 1) | I2C_MASTER_WRITE, true);
    i2c_master_stop(cmd);
    if (i2c_master_cmd_begin(I2C_MASTER_NUM, cmd, 10 / portTICK_PERIOD_MS) != ESP_OK) {
        addr = 0x3D;
    }
    i2c_cmd_link_delete(cmd);

    ESP_LOGI(TAG, "Initializing SSD1306 at 0x%02X", addr);
    ssd1306_init(&dev, I2C_MASTER_NUM, addr);
    
    // Show Logo
    ESP_LOGI(TAG, "Displaying boot logo...");
    ssd1306_clear(&dev);
    ssd1306_draw_bitmap(&dev, soundsense_logo);
    ssd1306_refresh(&dev);
    vTaskDelay(2000 / portTICK_PERIOD_MS);

    uint8_t data[64];
    uint8_t sync_byte;
    while (1) {
        // Look for Sync Header 0xFF
        if (uart_read_bytes(UART_NUM, &sync_byte, 1, portMAX_DELAY) > 0) {
            if (sync_byte == 0xFF) {
                // Read exactly 64 bytes of spectrum data
                int len = uart_read_bytes(UART_NUM, data, 64, 10 / portTICK_PERIOD_MS);
                if (len == 64) {
                    ssd1306_clear(&dev);
                    // Render 64 bars
                    for (int i = 0; i < 64; i++) {
                        // Data is 0-255, height is 0-64
                        int height = data[i] / 4; 
                        if (height > 64) height = 64;
                        
                        // Draw a 2-pixel wide bar for each band
                        for (int y = 0; y < height; y++) {
                            ssd1306_draw_pixel(&dev, i * 2, 63 - y, true);
                            ssd1306_draw_pixel(&dev, i * 2 + 1, 63 - y, true);
                        }
                    }
                    ssd1306_refresh(&dev);
                }
            }
        }
    }
}
